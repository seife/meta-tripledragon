## conf/layer.conf
```bitbake
# We have a conf and classes directory, add to BBPATH
BBPATH .= ":${LAYERDIR}"

# We have a recipes-* directories, add to BBFILES
BBFILES += "${LAYERDIR}/recipes-*/*/*.bb \
	${LAYERDIR}/recipes-*/*/*.bbappend"

BBFILE_COLLECTIONS += "tripledragon"
BBFILE_PATTERN_tripledragon = "^${LAYERDIR}/"
BBFILE_PRIORITY_tripledragon = "6"

# += always appends a space, so in order to make this match we need a | before (will be " |...")
# and a "| $" after the regex (in case another mask gets appended)
BBMASK += "|recipes-bsp/kernelgcc/(gcc-cross|gcc-cross-initial)_3\.4\.4\.bb| $"
```

## conf/machine/tripledragon.conf
```bitbake
#@TYPE: Machine
#@NAME: tripledragon

#@DESCRIPTION: Machine configuration for the TripleDragon Set Top Box

require conf/machine/generic-powerpc-4xx-softfloat.conf

SERIAL_CONSOLE = "115200 ttyS1"
# no VT
USE_VT = "0"

MACHINE_FEATURES = "ext2 ext3 serial"

# 2.16 is the latest eglibc to support kernels older than 2.6.16
EGLIBCVERSION = "2.16"
### we can actually build the newer glibc with newer headers,
### but....
#PREFERRED_VERSION_linux-libc-headers = "2.6.12.0"
#PREFERRED_VERSION_eglibc         = "${EGLIBCVERSION}"
#PREFERRED_VERSION_eglibc-initial = "${EGLIBCVERSION}"

### ...configure it to work with the old kernel :-)
OLDEST_KERNEL = "2.6.12"

### we don't need to build a kernel
#ASSUME_PROVIDED += "virtual/kernel"
# yes, we do. or we can't build td-dvb-wrapper :-)

PREFERRED_PROVIDER_virtual/kernel = "linux-tripledragon"

# we only have these binary blobs :-(
PREFERRED_VERSION_directfb = "0.9.24"

# do not install udev
VIRTUAL-RUNTIME_dev_manager = "busybox"
```
